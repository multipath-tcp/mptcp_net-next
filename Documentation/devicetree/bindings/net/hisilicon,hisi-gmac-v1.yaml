## Documentation/devicetree/bindings/net/hisilicon,hisi-gmac-v1.yaml
```yaml
# SPDX-License-Identifier: (GPL-2.0-only OR BSD-2-Clause)
%YAML 1.2
---
$id: http://devicetree.org/schemas/net/hisilicon,hisi-gmac-v1.yaml#
$schema: http://devicetree.org/meta-schemas/core.yaml#

title: Hisilicon GMAC controller

maintainers:
  - Jian Shen <shenjian15@huawei.com>
  - Jijie Shao <shaojijie@huawei.com>

allOf:
  - $ref: /schemas/net/ethernet-controller.yaml#
  - $ref: /schemas/net/mdio.yaml#

properties:
  compatible:
    oneOf:
      - items:
          - const: hisilicon,hix5hd2-gmac
          - const: hisilicon,hisi-gmac-v1
      - items:
          - const: hisilicon,hi3798cv200-gmac
          - const: hisilicon,hisi-gmac-v2

  reg:
    items:
      - description: MAC registers
      - description: External interface control register

  interrupts:
    maxItems: 1

  clocks:
    minItems: 1
    maxItems: 2

  clock-names:
    minItems: 1
    items:
      - const: mac_core
      - const: mac_ifc

  resets:
    minItems: 1
    maxItems: 3

  reset-names:
    minItems: 1
    items:
      - const: mac_core
      - const: mac_ifc
      - const: phy

  hisilicon,phy-reset-delays-us:
    description: Triplet of PHY reset delays in microseconds.
    items:
      - description: Pre-reset delay.
      - description: Reset pulse duration.
      - description: Post-reset delay.

required:
  - compatible
  - reg
  - interrupts
  - clocks
  - clock-names
  - phy-mode
  - phy-handle

unevaluatedProperties: false

examples:
  - |
    #include <dt-bindings/clock/histb-clock.h>

    ethernet@f9840000 {
        compatible = "hisilicon,hi3798cv200-gmac", "hisilicon,hisi-gmac-v2";
        reg = <0xf9840000 0x1000>, <0xf984300c 0x4>;
        interrupts = <0 71 4>;
        #address-cells = <1>;
        #size-cells = <0>;
        phy-mode = "rgmii";
        phy-handle = <&phy2>;
        mac-address = [00 00 00 00 00 00];
        clocks = <&crg HISTB_ETH0_MAC_CLK>, <&crg HISTB_ETH0_MACIF_CLK>;
        clock-names = "mac_core", "mac_ifc";
        resets = <&crg 0xcc 8>, <&crg 0xcc 10>, <&crg 0xcc 12>;
        reset-names = "mac_core", "mac_ifc", "phy";
        hisilicon,phy-reset-delays-us = <10000 10000 30000>;

        phy2: ethernet-phy@2 {
            reg = <2>;
        };
    };
```
